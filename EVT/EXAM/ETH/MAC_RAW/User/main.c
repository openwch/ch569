/********************************** (C) COPYRIGHT *******************************
 * File Name          : main.c
 * Author             : WCH
 * Version            : V1.0.0
 * Date               : 2022/05/31
 * Description        : Main program body.
*********************************************************************************
* Copyright (c) 2021 Nanjing Qinheng Microelectronics Co., Ltd.
* Attention: This software (modified or not) and binary are used for
* microcontroller manufactured by Nanjing Qinheng Microelectronics.
*******************************************************************************/
/*
 *@Note
MAC RAW example, demonstrating that MAC RAW receives and sends data.
 */
#include "string.h"
#include "CH56x_common.h"
#include "eth_driver.h"

extern volatile uint8_t LinkSta;
uint8_t MACAddr[6];                         //MAC address
UINT8 ARPPackage[]=
{
    0xff, 0xff, 0xff, 0xff, 0xff, 0xff,     /* destination MAC address */
    0x84, 0xc2, 0xe4, 0x01, 0x02, 0x03,     /* source MAC address */
    0x08,0x06,                              /* Type:ARP */
    0x00,0x01,                              /* Hardware type:Ethernet(1) */
    0x08,0x00,                              /* Protocol type:IPv4 */
    0x06,0x04,                              /* Hardware size and Protocol size*/
    0x00,0x01,                              /* Opcode:request(1) */
    0x84, 0xc2, 0xe4, 0x01, 0x02, 0x03,     /* Sender MAC address */
    0xc0,0xa8,0x1,0x0f,                     /* Sender IP address */
    0x00,0x00,0x00,0x00,0x00,0x00,          /* Target MAC address */
    0xc0,0xa8,0x1,0x64,                     /* Target IP address */
#if 1 /*padding 16 bytes * line numbers   */
    0x55,0x55,0x55,0x55,0x55,0x55,0x55,0x55,0x55,0x55,0x55,0x55,0x55,0x55,0x55,0x55,
    0x55,0x55,0x55,0x55,0x55,0x55,0x55,0x55,0x55,0x55,0x55,0x55,0x55,0x55,0x55,0x55,
    0x55,0x55,0x55,0x55,0x55,0x55,0x55,0x55,0x55,0x55,0x55,0x55,0x55,0x55,0x55,0x55,
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    0x55,0x55,0x55,0x55,0x55,0x55,0x55,0x55,0x55,0x55,0x55,0x55,0x55,0x55,0x55,0x55
#endif
};

/*******************************************************************************
 * @fn     DebugInit
 *
 * @brief  Initializes the UART1 peripheral.
 *
 * @param  baud rate: UART1 communication baud rate.
 *
 * @return  None
 */
void DebugInit(UINT32 baudrate)
{
    UINT32 x;
    UINT32 t = FREQ_SYS;

    x = 10 * t * 2 / 16 / baudrate;
    x = (x + 5) / 10;
    R8_UART1_DIV = 1;
    R16_UART1_DL = x;
    R8_UART1_FCR = RB_FCR_FIFO_TRIG | RB_FCR_TX_FIFO_CLR | RB_FCR_RX_FIFO_CLR | RB_FCR_FIFO_EN;
    R8_UART1_LCR = RB_LCR_WORD_SZ;
    R8_UART1_IER = RB_IER_TXD_EN;
    R32_PA_SMT |= (1 << 8) | (1 << 7);
    R32_PA_DIR |= (1 << 8);
}

/*********************************************************************
 * @fn      main
 *
 * @brief   Main program
 *
 * @return  none
 */
int main(void)
{
    uint8_t i;
    uint32_t PktCnt = 0;

    SystemInit(FREQ_SYS);
    Delay_Init(FREQ_SYS);
    DebugInit(115200);                                   //USART initialize
    printf("MAC RAW Test\r\n");
    ETH_GetMacAddr(MACAddr);                             //get the chip MAC address
    printf("mac addr:");
    for(i = 0; i < 6; i++) 
        printf("%x ",MACAddr[i]);
    printf("\n");
    ETH_Init(MACAddr);
    /* change source MAC address */
    memcpy(&ARPPackage[6], MACAddr, 6);
    memcpy(&ARPPackage[22], MACAddr, 6);

    while(1)
    {
        if(LinkSta)
        {
            MACRAW_Tx(ARPPackage, sizeof(ARPPackage));
            if(++PktCnt % 100 == 0)
                printf("PktCnt:%u\r\n",PktCnt);
            DelayMs(100);
        }
    }
}
